## package/python-pyframebuffer/Config.in
```kconfig
config BR2_PACKAGE_PYTHON_PYFRAMEBUFFER
	bool "python-pyframebuffer"
	help
	  A linux framebuffer primitives library written
	  in C and Python.
	  
	  https://github.com/RossAdrian/pyframebuffer
```
